## research/arm64/loader/configs/dockdsm_arm64_grub_defconfig
```kconfig
BR2_aarch64=y
BR2_cortex_a57=y
BR2_PACKAGE_HOST_LINUX_HEADERS_CUSTOM_6_12=y
BR2_DOWNLOAD_FORCE_CHECK_HASHES=y

BR2_TOOLCHAIN_BUILDROOT_GLIBC=y
BR2_PACKAGE_BUSYBOX=y
BR2_PACKAGE_KEXEC=y

BR2_LINUX_KERNEL=y
BR2_LINUX_KERNEL_CUSTOM_VERSION=y
BR2_LINUX_KERNEL_CUSTOM_VERSION_VALUE="6.12.112"
BR2_LINUX_KERNEL_USE_CUSTOM_CONFIG=y
BR2_LINUX_KERNEL_CUSTOM_CONFIG_FILE="board/qemu/aarch64-virt/linux.config"
BR2_LINUX_KERNEL_CONFIG_FRAGMENT_FILES="$(BR2_EXTERNAL_DOCKDSM_PATH)/board/arm64-kexec/linux-kexec.fragment"
BR2_LINUX_KERNEL_IMAGE=y

BR2_ROOTFS_OVERLAY="$(BR2_EXTERNAL_DOCKDSM_PATH)/board/arm64-kexec/rootfs-overlay"
BR2_ROOTFS_POST_IMAGE_SCRIPT="$(BR2_EXTERNAL_DOCKDSM_PATH)/board/arm64-kexec/post-image.sh $(BR2_EXTERNAL_DOCKDSM_PATH)/board/arm64-kexec/grub-post-image.sh support/scripts/genimage.sh"
BR2_ROOTFS_POST_SCRIPT_ARGS="-c $(BR2_EXTERNAL_DOCKDSM_PATH)/board/arm64-kexec/genimage-arm64-grub.cfg"
BR2_TARGET_ROOTFS_CPIO=y
BR2_TARGET_ROOTFS_CPIO_GZIP=y
BR2_TARGET_GENERIC_GETTY_PORT="ttyAMA0"

BR2_TARGET_GRUB2=y
BR2_TARGET_GRUB2_ARM64_EFI=y
BR2_TARGET_GRUB2_BUILTIN_MODULES_EFI="boot configfile echo fat linux normal part_gpt serial terminal"
BR2_PACKAGE_HOST_GENIMAGE=y
BR2_PACKAGE_HOST_DOSFSTOOLS=y
BR2_PACKAGE_HOST_MTOOLS=y
```

## research/arm64/loader/configs/dockdsm_arm64_kexec_defconfig
```kconfig
BR2_aarch64=y
BR2_cortex_a57=y
BR2_PACKAGE_HOST_LINUX_HEADERS_CUSTOM_6_12=y
BR2_DOWNLOAD_FORCE_CHECK_HASHES=y

BR2_TOOLCHAIN_BUILDROOT_GLIBC=y
BR2_PACKAGE_BUSYBOX=y
BR2_PACKAGE_KEXEC=y

BR2_LINUX_KERNEL=y
BR2_LINUX_KERNEL_CUSTOM_VERSION=y
BR2_LINUX_KERNEL_CUSTOM_VERSION_VALUE="6.12.112"
BR2_LINUX_KERNEL_USE_CUSTOM_CONFIG=y
BR2_LINUX_KERNEL_CUSTOM_CONFIG_FILE="board/qemu/aarch64-virt/linux.config"
BR2_LINUX_KERNEL_CONFIG_FRAGMENT_FILES="$(BR2_EXTERNAL_DOCKDSM_PATH)/board/arm64-kexec/linux-kexec.fragment"
BR2_LINUX_KERNEL_IMAGE=y

BR2_ROOTFS_OVERLAY="$(BR2_EXTERNAL_DOCKDSM_PATH)/board/arm64-kexec/rootfs-overlay"
BR2_ROOTFS_POST_IMAGE_SCRIPT="$(BR2_EXTERNAL_DOCKDSM_PATH)/board/arm64-kexec/post-image.sh"
BR2_TARGET_ROOTFS_CPIO=y
BR2_TARGET_ROOTFS_CPIO_GZIP=y
BR2_TARGET_GENERIC_GETTY_PORT="ttyAMA0"
```

## research/x86_64/grub-loader/configs/dockdsm_x86_64_grub_defconfig
```kconfig
BR2_x86_64=y
BR2_PACKAGE_HOST_LINUX_HEADERS_CUSTOM_6_12=y
BR2_DOWNLOAD_FORCE_CHECK_HASHES=y
BR2_REPRODUCIBLE=y
BR2_ROOTFS_OVERLAY="$(BR2_EXTERNAL_DOCKDSM_X86_PATH)/board/x86_64-grub/rootfs-overlay"
BR2_LINUX_KERNEL=y
BR2_LINUX_KERNEL_CUSTOM_VERSION=y
BR2_LINUX_KERNEL_CUSTOM_VERSION_VALUE="6.12.112"
BR2_LINUX_KERNEL_USE_CUSTOM_CONFIG=y
BR2_LINUX_KERNEL_CUSTOM_CONFIG_FILE="board/qemu/x86_64/linux.config"
BR2_LINUX_KERNEL_CONFIG_FRAGMENT_FILES="$(BR2_EXTERNAL_DOCKDSM_X86_PATH)/board/x86_64-grub/linux.fragment"
BR2_TARGET_ROOTFS_CPIO=y
BR2_TARGET_ROOTFS_ISO9660=y
BR2_TARGET_ROOTFS_ISO9660_INITRD=y
BR2_TARGET_ROOTFS_ISO9660_GRUB2=y
BR2_TARGET_ROOTFS_ISO9660_BOOT_MENU="$(BR2_EXTERNAL_DOCKDSM_X86_PATH)/board/x86_64-grub/grub.cfg"
BR2_TARGET_GRUB2=y
BR2_TARGET_GRUB2_I386_PC=y
BR2_TARGET_GRUB2_BUILTIN_MODULES_PC="boot linux iso9660 normal biosdisk"
BR2_TARGET_GRUB2_BOOT_PARTITION="cd"
BR2_TARGET_GRUB2_X86_64_EFI=y
BR2_TARGET_GRUB2_BUILTIN_MODULES_EFI="boot configfile linux iso9660 normal efi_gop part_gpt part_msdos"
BR2_TARGET_GRUB2_BUILTIN_CONFIG_EFI="$(BR2_EXTERNAL_DOCKDSM_X86_PATH)/board/x86_64-grub/grub-efi.cfg"
```
